## desktop/cpp/math/sinc_test/esp8266/sdkconfig.defaults
```kconfig
# idf_monitor.py only works in 74880 baudrate
#CONFIG_CONSOLE_UART_BAUDRATE=115200
#CONFIG_ESP_CONSOLE_UART_BAUDRATE=115200
CONFIG_CONSOLE_UART_BAUDRATE=9600
CONFIG_ESP_CONSOLE_UART_BAUDRATE=9600

# Try Float Printf/Scanf
CONFIG_NEWLIB_NANO_FORMAT=n
```

## embedded/esp8266/sndin/rtos/sdkconfig.defaults
```kconfig
# idf_monitor.py only works in 74880 baudrate
CONFIG_CONSOLE_UART_BAUDRATE=115200
CONFIG_ESP_CONSOLE_UART_BAUDRATE=115200
```
