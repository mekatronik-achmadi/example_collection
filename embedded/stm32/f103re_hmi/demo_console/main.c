/******************************************************************************/
/* This file has been generated by the uGFX-Studio                            */
/*                                                                            */
/* http://ugfx.org                                                            */
/******************************************************************************/

#include "gui.h"
#include "gfx.h"

#include "ch.h"
#include "hal.h"

static THD_WORKING_AREA(waBlink, 128);
static THD_FUNCTION(thdBlink, arg) {

  (void)arg;

  chRegSetThreadName("blinker");
  while (true) {
    palSetPad(GPIOE, 5);
    chThdSleepMilliseconds(500);
    palClearPad(GPIOE, 5);
    chThdSleepMilliseconds(500);
  }
}

int main(int argc, char* argv[])
{
	(void)argc;
	(void)argv;

	gfxInit();

	palSetPadMode(GPIOE,5,PAL_MODE_OUTPUT_PUSHPULL);
	chThdCreateStatic(waBlink, sizeof(waBlink), NORMALPRIO+1, thdBlink, NULL);

	gdispSetBacklight(100);
	gdispSetContrast(100);

	guiCreate();

	geventListenerInit(&glistener);
	gwinAttachListener(&glistener);
	geventAttachSource(&glistener, gwinKeyboardGetEventSource(ghKeyboard1), GLISTEN_KEYTRANSITIONS|GLISTEN_KEYUP);

	GEvent* pe;
	GEventKeyboard * pk;
	unsigned int i;

	while (1) {
		// Get an event
		pe = geventEventWait(&glistener, TIME_INFINITE);
		switch (pe->type) {
			case GEVENT_GWIN_BUTTON:
				if (((GEventGWinButton*)pe)->gwin == ghButton1){
					gwinClear(ghConsole1);
				}
				break;

			case GEVENT_KEYBOARD:
				pk = (GEventKeyboard *)pe;
				if (pk->bytecount){
					for (i = 0; i < pk->bytecount; i++){
						gwinPrintf(ghConsole1, "%c", pk->c[i] == 0x0D ? '\n' : pk->c[i]);
					}
				}
				break;
		}
	}

	return 0;
}


